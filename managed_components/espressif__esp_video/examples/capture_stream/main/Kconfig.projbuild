## managed_components/espressif__esp_video/examples/image_storage/sd_card/main/Kconfig.projbuild
```kconfig
menu "Example Configuration"
    menu "Video Encoding Configuration"
        choice EXAMPLE_ENCODING_FORMAT
            bool "Video encoding format"
            default EXAMPLE_FORMAT_MJPEG
            help
                Select the video encoding format for storing captured images/video.

                - MJPEG: Motion JPEG, stores each frame as a separate JPEG image
                - H.264: Advanced video compression for efficient storage and streaming

            config EXAMPLE_FORMAT_MJPEG
                bool "MJPEG (Motion JPEG)"
                help
                    Motion JPEG format stores video as a sequence of JPEG images.

                    Benefits:
                    - Simple format, easy to process
                    - Each frame is independently decodable
                    - Good compatibility with image viewers
                    - Lower CPU encoding requirements

                    Best for: Image sequences, simple video storage, or when
                    individual frame access is important.

            config EXAMPLE_FORMAT_H264
                bool "H.264 (Advanced Video Coding)"
                help
                    H.264 is a modern video compression standard providing
                    excellent compression efficiency.

                    Benefits:
                    - High compression efficiency (smaller file sizes)
                    - Industry-standard format
                    - Good streaming compatibility
                    - Configurable quality and bitrate

                    Best for: Video streaming, long recordings, or when
                    storage space efficiency is important.
        endchoice

        if EXAMPLE_FORMAT_MJPEG
            config EXAMPLE_JPEG_COMPRESSION_QUALITY
                int "JPEG compression quality (%)"
                default 80
                range 1 100
                help
                    JPEG compression quality percentage (1-100).

                    Higher values produce better image quality but larger file sizes:
                    - 90-100: Excellent quality, large files
                    - 70-90: Good quality, moderate file size (recommended)
                    - 50-70: Acceptable quality, smaller files
                    - 1-50: Poor quality, very small files

                    Recommended: 80 for a good balance of quality and file size.
        endif

        if EXAMPLE_FORMAT_H264
            config EXAMPLE_H264_I_PERIOD
                int "H.264 Intra Frame period (frames)"
                default 120
                range 1 120
                help
                    Number of frames between Intra (I) frames in the H.264 stream.

                    I-frames are complete, independently decodable frames that serve
                    as reference points for the video stream.

                    Smaller values (10-30):
                    - Better seek performance and error recovery
                    - Larger file sizes
                    - Better for streaming applications

                    Larger values (60-120):
                    - Better compression efficiency
                    - Smaller file sizes
                    - Suitable for storage applications

            config EXAMPLE_H264_BITRATE
                int "H.264 Target Bitrate (bps)"
                default 1000000
                range 25000 2500000
                help
                    Target bitrate for H.264 encoding in bits per second.

                    Higher bitrates produce better quality but larger files:
                    - 500,000 bps (500 kbps): Low quality, small files
                    - 1,000,000 bps (1 Mbps): Good quality (recommended)
                    - 2,000,000 bps (2 Mbps): High quality
                    - 5,000,000+ bps (5+ Mbps): Very high quality, large files

                    Consider your storage capacity and network bandwidth when choosing.

            config EXAMPLE_H264_MIN_QP
                int "H.264 Minimum quantization parameter (QP)"
                default 25
                range 1 51
                help
                    Minimum quantization parameter for H.264 encoding.

                    Lower QP values produce higher quality (and larger file sizes).
                    This sets the highest quality limit the encoder can achieve.

                    Typical values:
                    - 1-18: Lossless to very high quality
                    - 19-23: High quality (recommended minimum)
                    - 24-28: Good quality
                    - 29+: Lower quality

            config EXAMPLE_H264_MAX_QP
                int "H.264 Maximum quantization parameter (QP)"
                default 26
                range EXAMPLE_H264_MIN_QP 51
                help
                    Maximum quantization parameter for H.264 encoding.

                    Higher QP values produce lower quality (and smaller file sizes).
                    This sets the lowest quality limit to maintain target bitrate.

                    Must be greater than or equal to minimum QP.

                    Typical values:
                    - 23-28: High to good quality
                    - 29-35: Good to acceptable quality (recommended maximum)
                    - 36-45: Acceptable to poor quality
                    - 46-51: Poor quality
        endif
    endmenu

    menu "Example SD/MMC Configuration"

        config EXAMPLE_FORMAT_IF_MOUNT_FAILED
            bool "Format card if mount fails"
            default n
            help
                Automatically format the SD card if mounting fails.

                When enabled, the system will attempt to format the SD card
                with a fresh filesystem if the initial mount operation fails.

                Caution: This will erase all existing data on the SD card.
                Only enable if you want to automatically recover from
                filesystem corruption or use unformatted cards.

        config EXAMPLE_FORMAT_SD_CARD
            bool "Always format card at startup"
            default n
            help
                Format the SD card every time the example starts.

                When enabled, the SD card will be formatted with a fresh
                filesystem on every startup, erasing all existing data.

                Caution: This will permanently erase all data on the SD card.
                Only enable for testing or when you want to start with a
                clean filesystem every time.

        choice EXAMPLE_SDMMC_BUS_WIDTH
            prompt "SD/MMC bus width"
            default EXAMPLE_SDMMC_BUS_WIDTH_1
            help
                Select the data bus width for SD/MMC communication.

                4-line mode provides higher data transfer speeds but requires
                more GPIO pins. 1-line mode uses fewer pins but is slower.

                Important: Even in 1-line mode, the D3 pin must have a pull-up
                resistor connected to prevent the card from entering SPI mode.

            config EXAMPLE_SDMMC_BUS_WIDTH_4
                bool "4-line mode (D0-D3)"
                help
                    Use 4 data lines for faster data transfer.

                    Benefits:
                    - Higher data transfer speeds (up to 4x faster)
                    - Better performance for large files

                    Requirements:
                    - 4 additional GPIO pins (D0, D1, D2, D3)
                    - All data lines must have pull-up resistors

            config EXAMPLE_SDMMC_BUS_WIDTH_1
                bool "1-line mode (D0 only)"
                help
                    Use only 1 data line for communication.

                    Benefits:
                    - Fewer GPIO pins required
                    - Simpler wiring

                    Limitations:
                    - Slower data transfer speeds
                    - D3 pin still requires pull-up resistor
        endchoice

        choice EXAMPLE_SDMMC_SPEED_MODE
            prompt "SD/MMC speed mode"
            default EXAMPLE_SDMMC_SPEED_DS
            help
                Select the speed mode for SD/MMC communication.

                Higher speed modes provide faster data transfer but may require
                better signal integrity and compatible SD cards.

            config EXAMPLE_SDMMC_SPEED_DS
                bool "Default Speed (25 MHz)"
                help
                    Standard speed mode supported by all SD cards.

                    Speed: Up to 25 MHz clock, ~12.5 MB/s transfer rate
                    Compatibility: All SD cards

                    Best for: Maximum compatibility, basic applications.
            config EXAMPLE_SDMMC_SPEED_HS
                bool "High Speed (50 MHz)"
                help
                    High-speed mode for faster data transfer.

                    Speed: Up to 50 MHz clock, ~25 MB/s transfer rate
                    Compatibility: Most modern SD cards

                    Best for: Improved performance while maintaining good compatibility.
            config EXAMPLE_SDMMC_SPEED_UHS_I_SDR50
                bool "UHS-I SDR50 (100 MHz, 50 MB/s)"
                depends on SOC_SDMMC_UHS_I_SUPPORTED
                help
                    Ultra High Speed SDR50 mode for maximum performance.

                    Speed: Up to 100 MHz clock, ~50 MB/s transfer rate
                    Compatibility: UHS-I compatible SD cards only

                    Best for: High-performance applications requiring fast storage.
            config EXAMPLE_SDMMC_SPEED_UHS_I_DDR50
                bool "UHS-I DDR50 (50 MHz DDR, 50 MB/s)"
                depends on SOC_SDMMC_UHS_I_SUPPORTED
                help
                    Ultra High Speed DDR50 mode using double data rate.

                    Speed: 50 MHz clock with DDR, ~50 MB/s transfer rate
                    Compatibility: UHS-I compatible SD cards only

                    Best for: High-performance applications with DDR-compatible cards.
        endchoice

        if SOC_SDMMC_USE_GPIO_MATRIX

            config EXAMPLE_PIN_CMD
                int "CMD pin GPIO number"
                default 44 if IDF_TARGET_ESP32P4
                default 1
                help
                    GPIO pin for SD card command signal.
                    This pin carries command and response data.

            config EXAMPLE_PIN_CLK
                int "CLK pin GPIO number"
                default 43 if IDF_TARGET_ESP32P4
                default 1
                help
                    GPIO pin for SD card clock signal.
                    This pin provides the synchronization clock.

            config EXAMPLE_PIN_D0
                int "D0 pin GPIO number"
                default 39 if IDF_TARGET_ESP32P4
                default 1
                help
                    GPIO pin for SD card data line 0.
                    This is the primary data line used in both 1-line and 4-line modes.

            if EXAMPLE_SDMMC_BUS_WIDTH_4

                config EXAMPLE_PIN_D1
                    int "D1 pin GPIO number"
                    default 40 if IDF_TARGET_ESP32P4
                    default 1
                    help
                        GPIO pin for SD card data line 1.
                        Used only in 4-line mode.

                config EXAMPLE_PIN_D2
                    int "D2 pin GPIO number"
                    default 41 if IDF_TARGET_ESP32P4
                    default 1
                    help
                        GPIO pin for SD card data line 2.
                        Used only in 4-line mode.

                config EXAMPLE_PIN_D3
                    int "D3 pin GPIO number"
                    default 42 if IDF_TARGET_ESP32P4
                    default 1
                    help
                        GPIO pin for SD card data line 3.
                        Used only in 4-line mode, but must have pull-up even in 1-line mode.

            endif  # EXAMPLE_SDMMC_BUS_WIDTH_4

        endif  # SOC_SDMMC_USE_GPIO_MATRIX

        config EXAMPLE_DEBUG_PIN_CONNECTIONS
            bool "Debug sd pin connections and pullup strength"
            default n

        if !SOC_SDMMC_USE_GPIO_MATRIX
            config EXAMPLE_PIN_CMD
                depends on EXAMPLE_DEBUG_PIN_CONNECTIONS
                default 15

            config EXAMPLE_PIN_CLK
                depends on EXAMPLE_DEBUG_PIN_CONNECTIONS
                default 14

            config EXAMPLE_PIN_D0
                depends on EXAMPLE_DEBUG_PIN_CONNECTIONS
                default 2

            if EXAMPLE_SDMMC_BUS_WIDTH_4

                config EXAMPLE_PIN_D1
                    depends on EXAMPLE_DEBUG_PIN_CONNECTIONS
                    default 4

                config EXAMPLE_PIN_D2
                    depends on EXAMPLE_DEBUG_PIN_CONNECTIONS
                    default 12

                config EXAMPLE_PIN_D3
                    depends on EXAMPLE_DEBUG_PIN_CONNECTIONS
                    default 13

            endif  # EXAMPLE_SDMMC_BUS_WIDTH_4
        endif

        config EXAMPLE_ENABLE_ADC_FEATURE
            bool "Enable ADC signal level measurement"
            depends on EXAMPLE_DEBUG_PIN_CONNECTIONS
            default n
            help
                Enable ADC-based signal level measurement for SD card pins.

                This feature allows measuring actual voltage levels on SD card
                pins to verify proper pull-up resistor values and signal integrity.

                Useful for diagnosing connection issues and verifying hardware design.

        config EXAMPLE_ADC_UNIT
            int "ADC unit number"
            depends on EXAMPLE_ENABLE_ADC_FEATURE
            default 1
            help
                ADC unit number for signal level measurements.

                Choose an ADC unit that has channels corresponding to
                the SD card GPIO pins you want to measure.

        config EXAMPLE_ADC_PIN_CLK
            int "CLK pin ADC channel"
            depends on EXAMPLE_ENABLE_ADC_FEATURE
            default 1
            help
                ADC channel number corresponding to the CLK GPIO pin.
                Used for measuring clock signal levels.

        config EXAMPLE_ADC_PIN_CMD
            int "CMD pin ADC channel"
            depends on EXAMPLE_ENABLE_ADC_FEATURE
            default 1
            help
                ADC channel number corresponding to the CMD GPIO pin.
                Used for measuring command signal levels.

        config EXAMPLE_ADC_PIN_D0
            int "D0 pin ADC channel"
            depends on EXAMPLE_ENABLE_ADC_FEATURE
            default 1
            help
                ADC channel number corresponding to the D0 GPIO pin.
                Used for measuring data line 0 signal levels.

        if EXAMPLE_SDMMC_BUS_WIDTH_4

            config EXAMPLE_ADC_PIN_D1
                int "D1 pin ADC channel"
                depends on EXAMPLE_ENABLE_ADC_FEATURE
                default 1
                help
                    ADC channel number corresponding to the D1 GPIO pin.
                    Used for measuring data line 1 signal levels.

            config EXAMPLE_ADC_PIN_D2
                int "D2 pin ADC channel"
                depends on EXAMPLE_ENABLE_ADC_FEATURE
                default 1
                help
                    ADC channel number corresponding to the D2 GPIO pin.
                    Used for measuring data line 2 signal levels.

            config EXAMPLE_ADC_PIN_D3
                int "D3 pin ADC channel"
                depends on EXAMPLE_ENABLE_ADC_FEATURE
                default 1
                help
                    ADC channel number corresponding to the D3 GPIO pin.
                    Used for measuring data line 3 signal levels.

        endif  # EXAMPLE_SDMMC_BUS_WIDTH_4

        config EXAMPLE_SD_PWR_CTRL_LDO_INTERNAL_IO
            depends on SOC_SDMMC_IO_POWER_EXTERNAL
            bool "SD card powered by internal LDO (READ HELP!)"
            default y
            help
                Enable this option if your SD card is powered by an internal LDO regulator.

                Some ESP32 development boards connect the SD card VDD to an internal
                Low-Drop-Out (LDO) regulator output for power management.

                Check your board schematic to determine if the SD card VDD is connected to:
                - Internal LDO output: Enable this option
                - External power supply: Disable this option

                Incorrect setting may cause SD card detection or operation issues.

        config EXAMPLE_SD_PWR_CTRL_LDO_IO_ID
            depends on SOC_SDMMC_IO_POWER_EXTERNAL && EXAMPLE_SD_PWR_CTRL_LDO_INTERNAL_IO
            int "Internal LDO ID"
            default 4 if IDF_TARGET_ESP32P4
            help
                Internal LDO regulator ID that powers the SD card.

                Consult your development board schematic to determine which
                internal LDO regulator is connected to the SD card VDD pin.

                Common values:
                - ESP32-P4: LDO4 (default)
                - Other chips: Check board documentation

                Incorrect LDO ID may prevent proper SD card power management.
    endmenu
endmenu
```
