## managed_components/espressif__esp_video/examples/simple_video_server/main/Kconfig.projbuild
```kconfig
menu "Example Configuration"
    
    config EXAMPLE_CAMERA_VIDEO_BUFFER_NUMBER
        int "Camera video buffer number"
        default 2
        help
            Number of video buffers for the camera sensor.
            
            More buffers provide better performance and reduce frame drops,
            but consume more memory. Recommended range: 2-4 buffers.
            
            - 2 buffers: Minimum for basic operation
            - 3-4 buffers: Better performance for smooth streaming
            - Higher values: May improve performance but increase memory usage

    config EXAMPLE_JPEG_COMPRESSION_QUALITY
        int "JPEG compression quality (%)"
        default 80
        range 1 100
        help
            JPEG compression quality percentage (1-100).

            Higher values produce better image quality but larger data streams:
            - 90-100: Excellent quality, high bandwidth usage
            - 70-90: Good quality, moderate bandwidth (recommended for UVC)
            - 50-70: Acceptable quality, lower bandwidth
            - 1-50: Poor quality, minimal bandwidth

            For UVC streaming, consider the USB bandwidth limitations
            and host system capabilities when choosing quality level.

            Recommended: 80 for balanced quality and performance.

    config EXAMPLE_HTTP_PART_BOUNDARY
        string "HTTP part boundary"
        default "123456789000000000000987654321"
        help
            HTTP multipart boundary string used for MJPEG streaming.
            
            This boundary separates different parts in the HTTP multipart response.
            Must be unique and not appear in the video data. The default value
            is designed to be unique and safe for most applications.
    
    config EXAMPLE_MDNS_INSTANCE
        string "mDNS instance"
        default "web-cam"
        help
            mDNS instance name for service discovery.
            
            This name will be used to identify the camera service on the network.
            Other devices can discover this camera using this instance name
            through mDNS/Bonjour protocols.
    
    config EXAMPLE_MDNS_HOST_NAME
        string "mDNS host name"
        default "esp-web"
        help
            mDNS host name for the ESP32 device.
            
            This hostname will be used for network identification and can be
            accessed as "esp-web.local" on the local network (if mDNS is supported
            by the client device).
endmenu
```

## managed_components/espressif__esp_video/examples/simple_video_server/sdkconfig.defaults
```kconfig
CONFIG_LWIP_TCPIP_RECVMBOX_SIZE=64
CONFIG_LWIP_TCP_SND_BUF_DEFAULT=65535
CONFIG_LWIP_TCP_WND_DEFAULT=65535
CONFIG_LWIP_TCP_RECVMBOX_SIZE=64
CONFIG_LWIP_MAX_SOCKETS=22

CONFIG_PARTITION_TABLE_CUSTOM=y
CONFIG_PARTITION_TABLE_CUSTOM_FILENAME="partitions.csv"
CONFIG_PARTITION_TABLE_FILENAME="partitions.csv"

CONFIG_VFS_MAX_COUNT=10
```

## managed_components/espressif__esp_video/examples/simple_video_server/sdkconfig.defaults.esp32p4
```kconfig
CONFIG_CAMERA_SC2336=y

CONFIG_IDF_EXPERIMENTAL_FEATURES=y

CONFIG_SPIRAM=y
CONFIG_SPIRAM_SPEED_200M=y

CONFIG_ESP_VIDEO_ENABLE_ISP_PIPELINE_CONTROLLER=y

CONFIG_EXAMPLE_SELECT_ESP32P4_FUNCTION_EV_BOARD_V1_5=y
```

## managed_components/espressif__esp_video/examples/simple_video_server/sdkconfig.defaults.esp32s3
```kconfig
CONFIG_SPIRAM=y
CONFIG_SPIRAM_SPEED_80M=y
CONFIG_SPIRAM_MODE_OCT=y

CONFIG_ESP32S3_DEFAULT_CPU_FREQ_240=y

CONFIG_ESPTOOLPY_FLASHFREQ_80M=y
CONFIG_ESPTOOLPY_FLASHMODE_QIO=y
```

## managed_components/espressif__esp_video/examples/uvc/main/Kconfig.projbuild
```kconfig
menu "Example Configuration"

    if FORMAT_MJPEG_CAM1
        config EXAMPLE_JPEG_COMPRESSION_QUALITY
            int "JPEG compression quality (%)"
            default 80
            range 1 100
            help
                JPEG compression quality percentage (1-100).

                Higher values produce better image quality but larger data streams:
                - 90-100: Excellent quality, high bandwidth usage
                - 70-90: Good quality, moderate bandwidth (recommended for UVC)
                - 50-70: Acceptable quality, lower bandwidth
                - 1-50: Poor quality, minimal bandwidth

                For UVC streaming, consider the USB bandwidth limitations
                and host system capabilities when choosing quality level.

                Recommended: 80 for balanced quality and performance.
    endif

    if FORMAT_H264_CAM1
        config EXAMPLE_H264_I_PERIOD
            int "H.264 Intra Frame period (frames)"
            default 120
            range 1 120
            help
                Number of frames between Intra (I) frames in the H.264 stream.

                I-frames are complete, independently decodable frames that serve
                as reference points for the video stream.

                Smaller values (10-30):
                - Better seek performance and error recovery
                - Higher bandwidth usage
                - Better for streaming applications with packet loss

                Larger values (60-120):
                - Better compression efficiency
                - Lower bandwidth usage
                - Suitable for stable connections

                For UVC streaming, moderate values (60-120) balance compression
                efficiency with error recovery capabilities.

        config EXAMPLE_H264_BITRATE
            int "H.264 Target bitrate (bps)"
            default 1000000
            range 25000 2500000
            help
                Target bitrate for H.264 encoding in bits per second.

                Bitrate directly affects both quality and bandwidth usage:
                - 500,000 bps (500 kbps): Low quality, minimal bandwidth
                - 1,000,000 bps (1 Mbps): Good quality, moderate bandwidth (recommended)
                - 2,000,000 bps (2 Mbps): High quality, higher bandwidth
                - 5,000,000+ bps (5+ Mbps): Very high quality, maximum bandwidth

                Consider USB bandwidth limitations:
                - USB 2.0: ~35 MB/s theoretical, ~20 MB/s practical
                - USB 3.0+: Much higher bandwidth available

                Choose based on your USB interface and host capabilities.

        config EXAMPLE_H264_MIN_QP
            int "H.264 Minimum quantization parameter (QP)"
            default 25
            range 1 51
            help
                Minimum quantization parameter for H.264 encoding.

                Lower QP values produce higher quality (and larger bitrates).
                This sets the highest quality limit the encoder can achieve.

                Quantization scale:
                - 1-18: Lossless to very high quality
                - 19-23: High quality (recommended minimum for streaming)
                - 24-28: Good quality
                - 29+: Lower quality

                For UVC streaming, values 18-25 provide good quality while
                maintaining reasonable bandwidth requirements.

                Must be less than maximum QP value.

        config EXAMPLE_H264_MAX_QP
            int "H.264 Maximum quantization parameter (QP)"
            default 26
            range 1 51
            help
                Maximum quantization parameter for H.264 encoding.

                Higher QP values produce lower quality (and smaller bitrates).
                This sets the lowest quality limit to maintain target bitrate.

                Quantization scale:
                - 23-28: High to good quality
                - 29-35: Good to acceptable quality (recommended maximum)
                - 36-45: Acceptable to poor quality
                - 46-51: Poor quality

                For UVC streaming, the encoder will adjust QP between minimum
                and maximum values to maintain the target bitrate while
                preserving acceptable quality.

                Must be greater than or equal to minimum QP value.
    endif
endmenu
```

## managed_components/espressif__esp_video/examples/uvc/sdkconfig.defaults.esp32p4
```kconfig
CONFIG_CAMERA_SC2336=y

CONFIG_ESP_VIDEO_ENABLE_HW_H264_VIDEO_DEVICE=y
CONFIG_ESP_VIDEO_ENABLE_HW_JPEG_VIDEO_DEVICE=y

CONFIG_FORMAT_H264_CAM1=y

CONFIG_IDF_EXPERIMENTAL_FEATURES=y

CONFIG_SPIRAM_SPEED_200M=y

CONFIG_UVC_CAM1_FRAMERATE=30
```
