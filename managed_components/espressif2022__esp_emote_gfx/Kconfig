## managed_components/espressif__esp_cam_sensor/sensors/bf3901/Kconfig.bf3901
```kconfig
menuconfig CAMERA_BF3901
    bool "BF3901"
    default n
    help
        Enable support for the BF3901 CMOS image sensor.

if CAMERA_BF3901
    menu "Auto detect BF3901"
        config CAMERA_BF3901_AUTO_DETECT_SPI_INTERFACE_SENSOR
            bool "Detect for SPI interface sensor"
            default y
            help
                When enabled, the BF3901 sensor will be automatically detected
                and initialized on the SPI interface at startup without requiring
                manual detection call(bf3901_detect) in your application.
    endmenu

    choice CAMERA_BF3901_SPI_DEFAULT_FMT
        prompt "Select default output format for SPI interface"
        default CAMERA_BF3901_SPI_YUV422_240X320_15FPS if CAMERA_SENSOR_XCLK_INPUT_24M
        default CAMERA_BF3901_SPI_YUV422_120X160_5FPS
        help
            This option allows you to select the default video format for the BF3901 sensor
            when it is initialized on the SPI interface. The selected format will be used
            when the sensor is detected and initialized, and can be changed later when the
            sensor is in stream off state.

        config CAMERA_BF3901_SPI_RGB565_240X320_15FPS
            bool "RGB565 240x320 15fps, SPI 1-bit, 24M input"
            help
                RGB565 color format at 240x320 resolution with 15fps framerate.
                Requires 1-bit SPI interface with 24MHz input clock.
        config CAMERA_BF3901_SPI_YUV422_240X320_15FPS
            bool "YUV422 240x320 15fps, SPI 1-bit, 24M input"
            help
                YUV422 color format at 240x320 resolution with 15fps framerate.
                Requires 1-bit SPI interface with 24MHz input clock.
        config CAMERA_BF3901_SPI_YUV422_240X320_12FPS
            bool "YUV422 240x320 12fps, SPI 1-bit, 20M input"
            help
                YUV422 color format at 240x320 resolution with 12fps framerate.
                Requires 1-bit SPI interface with 20MHz input clock.
        config CAMERA_BF3901_SPI_YUV422_240X240_10FPS
            bool "YUV422 240x240 10fps, SPI 1-bit, 24M input"
            help
                YUV422 color format at 240x240 resolution with 10fps framerate.
                Requires 1-bit SPI interface with 24MHz input clock.
        config CAMERA_BF3901_SPI_YUV422_120X160_10FPS
            bool "YUV422 120x160 10fps, SPI 1-bit, 24M input"
            help
                YUV422 color format at 120x160 resolution with 10fps framerate.
                Requires 1-bit SPI interface with 24MHz input clock.
        config CAMERA_BF3901_SPI_YUV422_120X160_5FPS
            bool "YUV422 120x160 5fps, SPI 1-bit, 20M input"
            help
                YUV422 color format at 120x160 resolution with 5fps framerate.
                Requires 1-bit SPI interface with 20MHz input clock.
        config CAMERA_BF3901_SPI2_YUV422_240X320_20FPS
            bool "YUV422 240x320 20fps, SPI 2-bit 24M input"
            help
                YUV422 color format at 240x320 resolution with 20fps framerate.
                Requires 2-bit SPI interface with 24MHz input clock.
    endchoice # CAMERA_BF3901_SPI_DEFAULT_FMT

    config CAMERA_BF3901_SPI_IF_FORMAT_INDEX_DEFAULT
        int
        default 0 if CAMERA_BF3901_SPI_RGB565_240X320_15FPS
        default 1 if CAMERA_BF3901_SPI_YUV422_240X320_15FPS
        default 2 if CAMERA_BF3901_SPI_YUV422_240X320_12FPS
        default 3 if CAMERA_BF3901_SPI_YUV422_240X240_10FPS
        default 4 if CAMERA_BF3901_SPI_YUV422_120X160_10FPS
        default 5 if CAMERA_BF3901_SPI_YUV422_120X160_5FPS
        default 6 if CAMERA_BF3901_SPI2_YUV422_240X320_20FPS
        help
            Sets the default configuration for the SPI interface.
            Use query_support_formats() API to get more format options.
endif
```

## managed_components/espressif__esp_cam_sensor/sensors/bf3925/Kconfig.bf3925
```kconfig
menuconfig CAMERA_BF3925
    bool "BF3925"
    default n
    depends on SOC_LCDCAM_CAM_SUPPORTED
    help
        Enable support for the BF3925 CMOS image sensor.

if CAMERA_BF3925
    menu "Auto detect BF3925"
        config CAMERA_BF3925_AUTO_DETECT_DVP_INTERFACE_SENSOR
            bool "Detect for DVP interface sensor"
            default y
            help
                When enabled, the BF3925 sensor will be automatically detected
                and initialized on the DVP interface at startup without requiring
                manual detection call(bf3925_detect) in your application.
    endmenu

    choice CAMERA_BF3925_DVP_DEFAULT_FMT
        prompt "Select default output format for DVP interface"
        default CAMERA_BF3925_DVP_YUV422_1600X1200_9FPS
        help
            This option allows you to select the default video format for the BF3925 sensor
            when it is initialized on the DVP interface. The selected format will be used
            when the sensor is detected and initialized, and can be changed later when the
            sensor is in stream off state.

        config CAMERA_BF3925_DVP_YUV422_1600X1200_9FPS
            bool "YUV422 1600x1200 9fps, DVP 8-bit, 20M input"
            help
                YUV422 color format at 1600x1200 resolution (UXGA) with 9fps framerate.
                Requires 8-bit DVP interface and 20MHz input clock.
    endchoice # CAMERA_BF3925_DVP_DEFAULT_FMT

    config CAMERA_BF3925_DVP_IF_FORMAT_INDEX_DEFAULT
        int
        default 0 if CAMERA_BF3925_DVP_YUV422_1600X1200_9FPS
        help
            Sets the default configuration for the DVP interface.
            Use query_support_formats() API to get more format options.
endif
```

## managed_components/espressif__esp_cam_sensor/sensors/bf3a03/Kconfig.bf3a03
```kconfig
menuconfig CAMERA_BF3A03
    bool "BF3A03"
    default n
    depends on SOC_LCDCAM_CAM_SUPPORTED
    help
        Enable support for the BF3A03 CMOS image sensor.

if CAMERA_BF3A03
    menu "Auto detect BF3A03"
        config CAMERA_BF3A03_AUTO_DETECT_DVP_INTERFACE_SENSOR
            bool "Detect for DVP interface sensor"
            default y
            help
                When enabled, the BF3A03 sensor will be automatically detected
                and initialized on the DVP interface at startup without requiring
                manual detection call(bf3a03_detect) in your application.
    endmenu

    choice CAMERA_BF3A03_DVP_DEFAULT_FMT
        prompt "Select default output format for DVP interface"
        default CAMERA_BF3A03_DVP_YUV422_640X480_15FPS
        help
            This option allows you to select the default video format for the BF3A03 sensor
            when it is initialized on the DVP interface. The selected format will be used
            when the sensor is detected and initialized, and can be changed later when the
            sensor is in stream off state.

        config CAMERA_BF3A03_DVP_YUV422_640X480_15FPS
            bool "YUV422 640x480 15fps, DVP 8-bit, 20M input"
            help
                Standard color format using YUV422 at 640x480 resolution (VGA)
                with 15fps framerate. Requires 8-bit DVP interface and 20MHz input.

        config CAMERA_BF3A03_DVP_YUV422_MONO_640X480_15FPS
            bool "YUV422(MONO) 640x480 15fps, DVP 8-bit, 20M input"
            help
                Grayscale format using YUV422 mono at 640x480 resolution (VGA)
                with 15fps framerate. Requires 8-bit DVP interface and 20MHz input.
    endchoice # CAMERA_BF3A03_DVP_DEFAULT_FMT

    config CAMERA_BF3A03_DVP_IF_FORMAT_INDEX_DEFAULT
        int
        default 0 if CAMERA_BF3A03_DVP_YUV422_640X480_15FPS
        default 1 if CAMERA_BF3A03_DVP_YUV422_MONO_640X480_15FPS
        help
            Sets the default configuration for the DVP interface.
            Use query_support_formats() API to get more format options.
endif
```

## managed_components/espressif__esp_cam_sensor/sensors/gc0308/Kconfig.gc0308
```kconfig
menuconfig CAMERA_GC0308
    bool "GC0308"
    default n
    depends on SOC_LCDCAM_CAM_SUPPORTED
    help
        Enable support for the GC0308 CMOS image sensor.

if CAMERA_GC0308
    menu "Auto detect GC0308"
        config CAMERA_GC0308_AUTO_DETECT_DVP_INTERFACE_SENSOR
            bool "Detect for DVP interface sensor"
            default y
            help
                When enabled, the GC0308 sensor will be automatically detected
                and initialized on the DVP interface at startup without requiring
                manual detection call(gc0308_detect) in your application.
    endmenu

    choice CAMERA_GC0308_DVP_DEFAULT_FMT
        prompt "Select default output format for DVP interface"
        default CAMERA_GC0308_DVP_YUV422_640X480_16FPS
        help
            This option allows you to select the default video format for the GC0308 sensor
            when it is initialized on the DVP interface. The selected format will be used
            when the sensor is detected and initialized, and can be changed later when the
            sensor is in stream off state.

        config CAMERA_GC0308_DVP_YUV422_640X480_16FPS
            bool "YUV422 640x480 16fps, DVP 8-bit, 20M input"
            help
                Standard color format using YUV422 at 640x480 resolution (VGA)
                with 16fps framerate. Requires 8-bit DVP interface and 20MHz input.
        config CAMERA_GC0308_DVP_RGB565_640X480_16FPS
            bool "RGB565 640x480 16fps, DVP 8-bit, 20M input"
            help
                Standard color format using RGB565 at 640x480 resolution (VGA)
                with 16fps framerate. Requires 8-bit DVP interface and 20MHz input.
        config CAMERA_GC0308_DVP_GRAY_640X480_16FPS
            bool "Grayscale 640x480 16fps, DVP 8-bit, 20M input"
            help
                Grayscale format at 640x480 resolution (VGA) with 16fps framerate.
                Requires 8-bit DVP interface and 20MHz input.
        config CAMERA_GC0308_DVP_YUV422_320X240_20FPS
            bool "YUV422 320x240 20fps, DVP 8-bit, 20M input"
            help
                YUV422 color format at 320x240 resolution (QVGA) with 20fps framerate.
                Requires 8-bit DVP interface and 20MHz input.
        config CAMERA_GC0308_DVP_GRAY_320X240_20FPS
            bool "Grayscale 320x240 20fps, DVP 8-bit, 20M input"
            help
                Grayscale format at 320x240 resolution (QVGA) with 20fps framerate.
                Requires 8-bit DVP interface and 20MHz input.
        config CAMERA_GC0308_DVP_RGB565_320X240_20FPS
            bool "RGB565 320x240 20fps, DVP 8-bit, 20M input"
            help
                Standard color format using RGB565 at 320x240 resolution (QVGA)
                with 20fps framerate. Requires 8-bit DVP interface and 20MHz input.
    endchoice # CAMERA_GC0308_DVP_DEFAULT_FMT

    config CAMERA_GC0308_DVP_IF_FORMAT_INDEX_DEFAULT
        int
        default 0 if CAMERA_GC0308_DVP_YUV422_640X480_16FPS
        default 1 if CAMERA_GC0308_DVP_RGB565_640X480_16FPS
        default 2 if CAMERA_GC0308_DVP_GRAY_640X480_16FPS
        default 3 if CAMERA_GC0308_DVP_YUV422_320X240_20FPS
        default 4 if CAMERA_GC0308_DVP_GRAY_320X240_20FPS
        default 5 if CAMERA_GC0308_DVP_RGB565_320X240_20FPS
        help
            Sets the default configuration for the DVP interface.
            Use query_support_formats() API to get more format options.
endif
```
