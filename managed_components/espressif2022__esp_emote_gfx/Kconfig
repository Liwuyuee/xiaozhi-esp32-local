## managed_components/espressif__esp_cam_sensor/sensors/ov2640/Kconfig.ov2640
```kconfig
menuconfig CAMERA_OV2640
    bool "OV2640"
    default n
    depends on SOC_LCDCAM_CAM_SUPPORTED
    help
        Enable support for the OV2640 CMOS image sensor.

if CAMERA_OV2640
    menu "Auto detect OV2640"
        config CAMERA_OV2640_AUTO_DETECT_DVP_INTERFACE_SENSOR
            bool "Detect for DVP interface sensor"
            default y
            help
                When enabled, the OV2640 sensor will be automatically detected
                and initialized on the DVP interface at startup without requiring
                manual detection call(ov2640_detect) in your application.
    endmenu

    choice CAMERA_OV2640_DVP_DEFAULT_FMT
        prompt "Select default output format for DVP interface"
        default CAMERA_OV2640_DVP_YUV422_640X480_6FPS
        help
            This option allows you to select the default video format for the OV2640 sensor
            when it is initialized on the DVP interface. The selected format will be used
            when the sensor is detected and initialized, and can be changed later when the
            sensor is in stream off state.

        config CAMERA_OV2640_DVP_RGB565_640X480_6FPS
            bool "RGB565 640x480 6fps, DVP 8-bit, 20M input"
            help
                RGB565 color format at 640x480 resolution (VGA) with 6fps framerate.
                Requires 8-bit DVP interface and 20MHz input clock.
        config CAMERA_OV2640_DVP_YUV422_640X480_6FPS
            bool "YUV422 640x480 6fps, DVP 8-bit, 20M input"
            help
                YUV422 color format at 640x480 resolution (VGA) with 6fps framerate.
                Requires 8-bit DVP interface and 20MHz input clock.
        config CAMERA_OV2640_DVP_JPEG_640X480_25FPS
            bool "JPEG 640x480 25fps, DVP 8-bit, 20M input"
            help
                JPEG format at 640x480 resolution (VGA) with 25fps framerate.
                Requires 8-bit DVP interface and 20MHz input clock.
        config CAMERA_OV2640_DVP_RGB565_240X240_25FPS
            bool "RGB565 240x240 25fps, DVP 8-bit, 20M input"
            help
                RGB565 color format at 240x240 resolution with 25fps framerate.
                Requires 8-bit DVP interface and 20MHz input clock.
        config CAMERA_OV2640_DVP_YUV422_240X240_25FPS
            bool "YUV422 240x240 25fps, DVP 8-bit, 20M input"
            help
                YUV422 color format at 240x240 resolution with 25fps framerate.
                Requires 8-bit DVP interface and 20MHz input clock.
        config CAMERA_OV2640_DVP_JPEG_320X240_50FPS
            bool "JPEG 320x240 50fps, DVP 8-bit, 20M input"
            help
                JPEG format at 320x240 resolution (QVGA) with 50fps framerate.
                Requires 8-bit DVP interface and 20MHz input clock.
        config CAMERA_OV2640_DVP_JPEG_1280X720_12FPS
            bool "JPEG 1280x720 12fps, DVP 8-bit, 20M input"
            help
                JPEG format at 1280x720 resolution (HD) with 12fps framerate.
                Requires 8-bit DVP interface and 20MHz input clock.
        config CAMERA_OV2640_DVP_JPEG_1600X1200_12FPS
            bool "JPEG 1600x1200 12fps, DVP 8-bit, 20M input"
            help
                JPEG format at 1600x1200 resolution (UXGA) with 12fps framerate.
                Requires 8-bit DVP interface and 20MHz input clock.
        config CAMERA_OV2640_DVP_RAW8_800X640_30FPS
            bool "RAW8 800x640 30fps, DVP 8-bit, 20M input"
            help
                RAW8 format at 800x640 resolution with 30fps framerate.
                Requires 8-bit DVP interface and 20MHz input clock.
        config CAMERA_OV2640_DVP_RAW8_800X640_15FPS
            bool "RAW8 800x640 15fps, DVP 8-bit, 20M input"
            help
                RAW8 format at 800x640 resolution with 15fps framerate.
                Requires 8-bit DVP interface and 20MHz input clock.
        config CAMERA_OV2640_DVP_RAW8_800X800_15FPS
            bool "RAW8 800x800 15fps, DVP 8-bit, 20M input"
            help
                RAW8 format at 800x800 resolution with 15fps framerate.
                Requires 8-bit DVP interface and 20MHz input clock.
        config CAMERA_OV2640_DVP_RAW8_1024X600_15FPS
            bool "RAW8 1024x600 15fps, DVP 8-bit, 20M input"
            help
                RAW8 format at 1024x600 resolution with 15fps framerate.
                Requires 8-bit DVP interface and 20MHz input clock.
    endchoice # CAMERA_OV2640_DVP_DEFAULT_FMT

    config CAMERA_OV2640_DVP_IF_FORMAT_INDEX_DEFAULT
        int
        default 0 if CAMERA_OV2640_DVP_RGB565_640X480_6FPS
        default 1 if CAMERA_OV2640_DVP_YUV422_640X480_6FPS
        default 2 if CAMERA_OV2640_DVP_JPEG_640X480_25FPS
        default 3 if CAMERA_OV2640_DVP_RGB565_240X240_25FPS
        default 4 if CAMERA_OV2640_DVP_YUV422_240X240_25FPS
        default 5 if CAMERA_OV2640_DVP_JPEG_320X240_50FPS
        default 6 if CAMERA_OV2640_DVP_JPEG_1280X720_12FPS
        default 7 if CAMERA_OV2640_DVP_JPEG_1600X1200_12FPS
        default 8 if CAMERA_OV2640_DVP_RAW8_800X640_30FPS
        default 9 if CAMERA_OV2640_DVP_RAW8_800X640_15FPS
        default 10 if CAMERA_OV2640_DVP_RAW8_800X800_15FPS
        default 11 if CAMERA_OV2640_DVP_RAW8_1024X600_15FPS
        help
            Sets the default configuration for the DVP interface.
            Use query_support_formats() API to get more format options.
endif
```

## managed_components/espressif__esp_cam_sensor/sensors/ov2710/Kconfig.ov2710
```kconfig
menuconfig CAMERA_OV2710
    bool "OV2710"
    default n
    depends on SOC_MIPI_CSI_SUPPORTED
    help
        Enable support for the OV2710 CMOS image sensor.

if CAMERA_OV2710
    menu "Auto detect OV2710"
        config CAMERA_OV2710_AUTO_DETECT_MIPI_INTERFACE_SENSOR
            bool "Detect for MIPI CSI interface sensor"
            default y
            help
                When enabled, the OV2710 sensor will be automatically detected
                and initialized on the MIPI CSI interface at startup without requiring
                manual detection call(ov2710_detect) in your application.
    endmenu

    choice CAMERA_OV2710_MIPI_DEFAULT_FMT
        prompt "Select default output format for MIPI CSI interface"
        default CAMERA_OV2710_MIPI_RAW10_1920X1080_25FPS
        help
            This option allows you to select the default video format for the OV2710 sensor
            when it is initialized on the MIPI CSI interface. The selected format will be used
            when the sensor is detected and initialized, and can be changed later when the
            sensor is in stream off state.

        config CAMERA_OV2710_MIPI_RAW10_1920X1080_25FPS
            bool "RAW10 1920x1080 25fps, MIPI 1-lane, 24M input"
            help
                RAW10 format at 1920x1080 resolution (FHD) with 25fps framerate.
                Requires MIPI CSI-2 1-lane interface with 24MHz input clock.
        config CAMERA_OV2710_MIPI_RAW10_1280X720_25FPS
            bool "RAW10 1280x720 25fps, MIPI 1-lane, 24M input"
            help
                RAW10 format at 1280x720 resolution (HD) with 25fps framerate.
                Requires MIPI CSI-2 1-lane interface with 24MHz input clock.
    endchoice # CAMERA_OV2710_MIPI_DEFAULT_FMT

    config CAMERA_OV2710_MIPI_IF_FORMAT_INDEX_DEFAULT
        int
        default 0 if CAMERA_OV2710_MIPI_RAW10_1920X1080_25FPS
        default 1 if CAMERA_OV2710_MIPI_RAW10_1280X720_25FPS
        help
            Set the configuration loaded by default for the MIPI CSI interface.
            More information can be obtained by calling the query_support_formats().

    config CAMERA_OV2710_STATS_UPDATE_EN
        bool "Enable sensor statistics updates"
        default y
        help
            Enable periodic updates of sensor statistics such as exposure, gain,
            and white balance parameters. This allows real-time monitoring and
            adjustment of sensor performance.

            When enabled, a timer will periodically refresh sensor statistics
            to provide up-to-date information about sensor operation.

    config CAMERA_OV2710_STATS_UPDATE_INTERVAL
        int "Statistics update interval (milliseconds)"
        range 0 2000
        default 120
        depends on CAMERA_OV2710_STATS_UPDATE_EN
        help
            Set the interval for updating sensor statistics.

            Recommended values:
            - 50-100ms: High-frequency updates for real-time applications
            - 120ms: Default balanced update rate
            - 200-500ms: Lower frequency for power-sensitive applications
            - 1000ms+: Minimal updates for basic monitoring

            Lower values provide more responsive statistics but consume more CPU.

    choice CAMERA_OV2710_IPA_JSON_CONFIGURATION_FILE
        prompt "IPA Configuration File"
        default CAMERA_OV2710_DEFAULT_IPA_JSON_CONFIGURATION_FILE
        help
            Select the Image Processing Algorithm (IPA) JSON configuration file
            for the OV2710 sensor.

        config CAMERA_OV2710_DEFAULT_IPA_JSON_CONFIGURATION_FILE
            bool "Use default configuration"
            help
                Use the built-in default IPA configuration file:
                "esp_cam_sensor/sensors/ov2710/cfg/ov2710_default.json"

                This configuration provides optimized settings for general use cases
                and is recommended for most applications.

        config CAMERA_OV2710_CUSTOMIZED_IPA_JSON_CONFIGURATION_FILE
            bool "Use custom configuration"
            help
                Use a custom IPA configuration file with your own optimized settings.

                This option allows you to fine-tune sensor parameters for specific
                lighting conditions, color requirements, or application needs.

                You must specify the custom file path in the configuration below.
    endchoice

    config CAMERA_OV2710_CUSTOMIZED_IPA_JSON_CONFIGURATION_FILE_PATH
        string "Custom IPA configuration file path"
        depends on CAMERA_OV2710_CUSTOMIZED_IPA_JSON_CONFIGURATION_FILE
        help
            Specify the path to your custom OV2710 IPA JSON configuration file.

            The path is relative to your project root directory.

            Example: "components/my_camera_config/ov2710_custom.json"

            Ensure the file exists and contains valid JSON configuration
            parameters compatible with the OV2710 sensor.
endif
```

## managed_components/espressif__esp_cam_sensor/sensors/ov3660/Kconfig.ov3660
```kconfig
menuconfig CAMERA_OV3660
    bool "OV3660"
    default n
    depends on SOC_LCDCAM_CAM_SUPPORTED
    help
        Enable support for the OV3660 CMOS image sensor.

if CAMERA_OV3660
    menu "Auto detect OV3660"
        config CAMERA_OV3660_AUTO_DETECT_DVP_INTERFACE_SENSOR
            bool "Detect for DVP interface sensor"
            default y
            help
                When enabled, the OV3660 sensor will be automatically detected
                and initialized on the DVP interface at startup without requiring
                manual detection call(ov3660_detect) in your application.
    endmenu

    choice CAMERA_OV3660_DVP_DEFAULT_FMT
        prompt "Select default output format for DVP interface"
        default CAMERA_OV3660_DVP_YUV422_640X480_10FPS
        help
            This option allows you to select the default video format for the OV3660 sensor
            when it is initialized on the DVP interface. The selected format will be used
            when the sensor is detected and initialized, and can be changed later when the
            sensor is in stream off state.

        config CAMERA_OV3660_DVP_RGB565_240X240_24FPS
            bool "RGB565 240x240 24fps, DVP 8-bit, 20M input"
            help
                RGB565 color format at 240x240 resolution with 24fps framerate.
                Requires 8-bit DVP interface and 20MHz input clock.
        config CAMERA_OV3660_DVP_YUV422_240X240_24FPS
            bool "YUV422 240x240 24fps, DVP 8-bit, 20M input"
            help
                YUV422 color format at 240x240 resolution with 24fps framerate.
                Requires 8-bit DVP interface and 20MHz input clock.
        config CAMERA_OV3660_DVP_RGB565_640X480_10FPS
            bool "RGB565 640x480 10fps, DVP 8-bit, 20M input"
            help
                RGB565 color format at 640x480 resolution (VGA) with 10fps framerate.
                Requires 8-bit DVP interface and 20MHz input clock.
        config CAMERA_OV3660_DVP_YUV422_640X480_10FPS
            bool "YUV422 640x480 10fps, DVP 8-bit, 20M input"
            help
                YUV422 color format at 640x480 resolution (VGA) with 10fps framerate.
                Requires 8-bit DVP interface and 20MHz input clock.
        config CAMERA_OV3660_DVP_JPEG_1280X720_12FPS
            bool "JPEG 1280x720 12fps, DVP 8-bit, 10M input"
            help
                JPEG format at 1280x720 resolution (HD) with 12fps framerate.
                Requires 8-bit DVP interface and 10MHz input clock.
    endchoice # CAMERA_OV3660_DVP_DEFAULT_FMT

    config CAMERA_OV3660_DVP_IF_FORMAT_INDEX_DEFAULT
        int
        default 0 if CAMERA_OV3660_DVP_RGB565_240X240_24FPS
        default 1 if CAMERA_OV3660_DVP_YUV422_240X240_24FPS
        default 2 if CAMERA_OV3660_DVP_RGB565_640X480_10FPS
        default 3 if CAMERA_OV3660_DVP_YUV422_640X480_10FPS
        default 4 if CAMERA_OV3660_DVP_JPEG_1280X720_12FPS
        help
            Sets the default configuration for the DVP interface.
            Use query_support_formats() API to get more format options.
endif
```
